## scoreboard_broadcaster_nRF52840DK/build/Kconfig/Kconfig.shield
```kconfig
osource "c:/nordic/myapps/bt-fund-main/lesson1/blefund_less1_exer1/boards/shields/*/Kconfig.shield"
osource "c:/nordic/ncs-fund-main/ncs-fund-main/v2.x.x/lesson6/fund_less6_exer1_solution/boards/shields/*/Kconfig.shield"
osource "c:/nordic/myapps/bt-fund-main/lesson2/blefund_less2_exer1_solution/boards/shields/*/Kconfig.shield"
osource "c:/nordic/myapps/bt-fund-main/lesson2/blefund_less2_exer2_solution/boards/shields/*/Kconfig.shield"
osource "c:/nordic/myapps/scoreboard/scoreboard_broadcaster_nrf52840dk/boards/shields/*/Kconfig.shield"
osource "c:/ncs/v2.4.2/nrf/samples/bluetooth/mesh/light/boards/shields/*/Kconfig.shield"
osource "c:/ncs/v2.4.2/nrf/samples/bluetooth/throughput/boards/shields/*/Kconfig.shield"
osource "c:/nordic/myapps/scoreboard/scoreboard_observer_nrf52840dk/boards/shields/*/Kconfig.shield"
osource "C:/ncs/v2.4.2/nrf/boards/shields/*/Kconfig.shield"
```
